## meta-oven-controller-app/conf/layer.conf
```bitbake
# We have a conf and classes directory, add to BBPATH
BBPATH .= ":${LAYERDIR}"

# We have recipes-* directories, add to BBFILES
BBFILES += "${LAYERDIR}/recipes-*/*/*.bb \
            ${LAYERDIR}/recipes-*/*/*.bbappend"

BBFILE_COLLECTIONS += "oven-controller-app"
BBFILE_PATTERN_oven-controller-app = "^${LAYERDIR}/"
BBFILE_PRIORITY_oven-controller-app = "6"

LAYERDEPENDS_oven-controller-app = "core"
LAYERSERIES_COMPAT_oven-controller-app = "honister"
```

## meta-oven-controller-bsp/conf/layer.conf
```bitbake
# We have a conf and classes directory, add to BBPATH
BBPATH .= ":${LAYERDIR}"

# We have recipes-* directories, add to BBFILES
BBFILES += "${LAYERDIR}/recipes-*/*/*.bb \
            ${LAYERDIR}/recipes-*/*/*.bbappend"

BBFILE_COLLECTIONS += "meta-oven-controller-bsp"
BBFILE_PATTERN_meta-oven-controller-bsp = "^${LAYERDIR}/"
BBFILE_PRIORITY_meta-oven-controller-bsp = "6"

LAYERDEPENDS_meta-oven-controller-bsp = "core"
LAYERSERIES_COMPAT_meta-oven-controller-bsp = "honister"
```

## meta-oven-controller-gui/conf/layer.conf
```bitbake
# We have a conf and classes directory, add to BBPATH
BBPATH .= ":${LAYERDIR}"

# We have recipes-* directories, add to BBFILES
BBFILES += "${LAYERDIR}/recipes-*/*/*.bb \
            ${LAYERDIR}/recipes-*/*/*.bbappend"

BBFILE_COLLECTIONS += "oven-controller-gui"
BBFILE_PATTERN_oven-controller-gui = "^${LAYERDIR}/"
BBFILE_PRIORITY_oven-controller-gui = "6"

LAYERDEPENDS_oven-controller-gui = "core"
LAYERSERIES_COMPAT_oven-controller-gui = "honister"
```

## meta-oven-controller/conf/layer.conf
```bitbake
# We have a conf and classes directory, add to BBPATH
BBPATH .= ":${LAYERDIR}"

# We have recipes-* directories, add to BBFILES
BBFILES += "${LAYERDIR}/recipes-*/*/*.bb \
            ${LAYERDIR}/recipes-*/*/*.bbappend"

BBFILE_COLLECTIONS += "meta-oven-controller"
BBFILE_PATTERN_meta-oven-controller = "^${LAYERDIR}/"
BBFILE_PRIORITY_meta-oven-controller = "6"

LAYERDEPENDS_meta-oven-controller = "core"
LAYERSERIES_COMPAT_meta-oven-controller = "honister"
```
